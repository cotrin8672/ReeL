## boards/shields/reel/Kconfig.defconfig
```kconfig
if SHIELD_REEL_RIGHT

config ZMK_KEYBOARD_NAME
    default "ReeL"

config ZMK_SPLIT_ROLE_CENTRAL
    default y

config ZMK_POINTING
    default y

config SPI
    default y

config LS0XX_VCOM_THREAD_PRIO
    default 11

config LV_Z_VDB_SIZE
    default 100

config LV_DPI_DEF
    default 161

config LV_Z_BITS_PER_PIXEL
    default 1

choice LV_COLOR_DEPTH
    default LV_COLOR_DEPTH_1
endchoice

choice ZMK_DISPLAY_WORK_QUEUE
    default ZMK_DISPLAY_WORK_QUEUE_DEDICATED
endchoice

choice ZMK_DISPLAY_STATUS_SCREEN
    default ZMK_DISPLAY_STATUS_SCREEN_BUILT_IN
endchoice

endif

if SHIELD_REEL_LEFT || SHIELD_REEL_RIGHT

config ZMK_SPLIT
    default y

endif
```

## boards/shields/reel/Kconfig.shield
```kconfig
config SHIELD_REEL_LEFT
    def_bool $(shields_list_contains,reel_left)

config SHIELD_REEL_RIGHT
    def_bool $(shields_list_contains,reel_right)
```

## config/west.yml
```yaml
manifest:
  defaults:
    revision: 904c9aec8822d79149d42c8a9a77e8828eb08f5a
  remotes:
    - name: zmkfirmware
      url-base: https://github.com/zmkfirmware
  projects:
    - name: zmk
      remote: zmkfirmware
      import: app/west.yml
  self:
    path: config
```
